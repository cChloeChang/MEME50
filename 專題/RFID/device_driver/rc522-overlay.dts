/dts-v1/;
/plugin/;

/ {
    compatible = "brcm,bcm2712";
 
    fragment@0 {
        target = <&spi0>;
        __overlay__ {
            #address-cells = <1>;
            #size-cells = <0>;

            rc522@0 {
                compatible = "rfid,rc522";
                reg = <0>;
                spi-max-frequency = <10000000>;
                reset-gpios = <&gpio 25 0>;
            };
        };
    };

    fragment@99 {
        target = <&spi0>;
        __overlay__ {
	        #address-cells = <1>;
        	#size-cells = <0>;
            spidev@0 {
		reg = <0>;
                status = "disabled";
            };
        };
    };
};

